## conf/layer.conf
```bitbake
#
# Copyright (c) Siemens AG, 2023
#
# SPDX-License-Identifier: MIT

BBPATH .= ":${LAYERDIR}"

BBFILES += "${LAYERDIR}/recipes-*/*/*.bb ${LAYERDIR}/recipes-*/*/*.bbappend"

BBFILE_COLLECTIONS += "rt-testing-images"
BBFILE_PATTERN_rt-testing-images = "^${LAYERDIR}/recipes-"

LAYERSERIES_COMPAT_rt-testing-images = "next"

LAYERDIR_rt-testing-images = "${LAYERDIR}"

ISAR_RELEASE_CMD = "git -C ${LAYERDIR} describe --all --long --dirty"
```
