## conf/distro/osadl-rt-test-xenomai.conf
```bitbake
#
# Xenomai Real-Time System
#
# Copyright (c) Siemens AG, 2018-2025
#
# Authors:
#  Jan Kiszka <jan.kiszka@siemens.com>
#
# SPDX-License-Identifier: MIT
#

COMPAT_DISTRO_ARCH:arm64 = "armhf"

XENOMAI_MAJOR_VERSION = "4"
PREFERRED_VERSION_libevl = "next"

require conf/distro/xenomai-demo.conf

WKS_FILE = "${WKS_FILE_NAME}"

KERNEL_DEFCONFIG = ""
KERNEL_NAME = "xenomai-4"
PREFERRED_VERSION_linux-xenomai-4 = "9999-%"
LATEST_GIT_BRANCH = "latest"
```

## conf/distro/raspios-trixie.conf
```bitbake
# Raspberry Pi OS trixie distribution configuration
#
# Based on isar/meta-isar/conf/distro/raspios-bookworm.conf

BASE_DISTRO = "raspios"
BASE_DISTRO:arm64 = "raspios64"

HOST_BASE_DISTRO ?= "debian"

BASE_DISTRO_CODENAME = "trixie"
HOST_DISTRO ?= "debian-trixie"
HOST_DISTRO_APT_SOURCES ?= "conf/distro/${HOST_DISTRO}.list"

DISTRO_APT_SOURCES ?= "conf/distro/raspios-trixie.list"
DISTRO_APT_SOURCES:arm64 ?= "conf/distro/raspios-trixie-64.list"

DISTRO_BOOTSTRAP_KEYS = "http://raspbian.raspberrypi.org/raspbian.public.key;sha256sum=ca59cd4f2bcbc3a1d41ba6815a02a8dc5c175467a59bd87edeac458f4a5345de"
DISTRO_BOOTSTRAP_KEYS:arm64 = ""

DISTRO_KERNELS ?= "kernel kernel7 kernel7l kernel8"

# The RPi archive GPG key uses SHA1 signatures, rejected by sqv/apt since
# 2026-02-01. Authentication is handled via [trusted=yes] in the .list files
# instead. Importing this key into distro-keyring.gpg would break the host
# (debian-trixie) bootstrap, as apt can't verify Debian packages with only
# the RPi key in the keyring.
# THIRD_PARTY_APT_KEYS += "http://archive.raspberrypi.org/debian/raspberrypi.gpg.key;sha256sum=76603890d82a492175caf17aba68dc73acb1189c9fd58ec0c19145dfa3866d56"

COMPAT_DISTRO_ARCH:arm64 = "armhf"

# In trixie, raspberrypi-bootloader was renamed to raspi-firmware
# and raspberrypi-kernel/raspberrypi-kernel-headers are no longer provided
# (trixie uses upstream Debian kernels). Override rpi-common.conf defaults.
IMAGE_PREINSTALL:remove = "raspberrypi-bootloader"
IMAGE_PREINSTALL += "raspi-firmware"
# Custom kernel is built from source; no distro kernel package needed
KERNEL_IMAGE_PKG = ""
KERNEL_HEADERS_PKG = ""

# python3-distutils was removed in Python 3.12+ (merged into setuptools)
IMAGER_INSTALL:wic:remove = "python3-distutils"

DISTRO_GCC = "14"

DEBIAN_STANDARDS_VERSION ?= "4.7.2"
```

## conf/machine/raspberry-pi4.conf
```bitbake
#
# Copyright (c) Siemens AG, 2023
#
# Authors:
#  Tobias Schaffner <tobias.schaffner@siemens.com>
#
# SPDX-License-Identifier: MIT

DISTRO_ARCH ?= "arm64"
KERNEL_NAME = "raspberry-pi4"

BOOT_SPACE ?= "81920"
MACHINE_SERIAL ?= "serial0"
BAUDRATE_TTY ?= "115200"

IMAGE_FSTYPES = "wic"
WKS_FILE = "rpi-sdimg"

IMAGE_PREINSTALL = "raspberrypi-bootloader \
		    raspi-config \
		    systemd-sysv"

IMAGE_INSTALL += "bootconfig-rpi-custom-kernel"

WIC_IMAGER_INSTALL = "parted \
                      dosfstools \
                      mtools \
                      e2fsprogs \
                      python3-distutils \
                      bmap-tools"

IMAGE_BOOT_FILES ?= "${IMAGE_ROOTFS}/boot/*.*;./ \
                     ${IMAGE_ROOTFS}/boot/overlays/*;overlays/ \
		     ${IMAGE_ROOTFS}/usr/lib/linux-image-${KERNEL_VERSION}*/broadcom/*;./ \
		     ${IMAGE_ROOTFS}/usr/lib/linux-image-5.15.92-rt66-isar*/overlays/*;overlays/"
```
